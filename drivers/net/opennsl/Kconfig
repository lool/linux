## drivers/net/opennsl/Kconfig
```kconfig
#
# OpenNSL configuration
#

menuconfig OPENNSL
	depends on NET

config OPENNSL_KERNEL_BDE
	default y
	tristate "OpenNSL kernel BDE"

config OPENNSL_BCM_KNET
	default y
	depends on OPENNSL_KERNEL_BDE
	tristate "OpenNSL KNET support"

config OPENNSL_USER_BDE
	default y
	depends on OPENNSL_KERNEL_BDE
	tristate "OpenNSL user BDE"
```
